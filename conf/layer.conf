## conf/layer.conf
```bitbake
# We have a conf and classes directory, add to BBPATH
BBPATH .= ":${LAYERDIR}"

# We have recipes-* directories, add to BBFILES
BBFILES += "${LAYERDIR}/recipes-*/*/*.bb \
            ${LAYERDIR}/recipes-*/*/*.bbappend"

BBFILE_COLLECTIONS += "meta-fakeapate-cm4"
BBFILE_PATTERN_meta-fakeapate-cm4 = "^${LAYERDIR}/"
BBFILE_PRIORITY_meta-fakeapate-cm4 = "6"

LAYERDEPENDS_meta-fakeapate-cm4 = "core"
LAYERSERIES_COMPAT_meta-fakeapate-cm4 = "scarthgap"
```
